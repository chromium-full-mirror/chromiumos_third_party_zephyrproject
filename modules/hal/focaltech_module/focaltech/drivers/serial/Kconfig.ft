## modules/hal/focaltech_module/soc/ft/Kconfig
```kconfig
# Copyright (c) 2025 Focaltech Systems CO.,Ltd
# SPDX-License-Identifier: Apache-2.0

config SOC_FAMILY_FOCALTECH
	select BUILD_OUTPUT_HEX
	select HAS_SEGGER_RTT if ZEPHYR_SEGGER_MODULE

if SOC_FAMILY_FOCALTECH

rsource "*/Kconfig"

endif # SOC_FAMILY_FOCALTECH
```
