## modules/hal/focaltech_module/focaltech/drivers/serial/Kconfig.ft
```kconfig
# SPDX-License-Identifier: Apache-2.0

config UART_FOCALTECH
	bool "FT90 MCU serial driver"
	default y
	depends on SERIAL
	depends on SOC_FAMILY_FOCALTECH
	select SERIAL_HAS_DRIVER
	select USE_FOCALTECH_HAL_UART
	select SERIAL_SUPPORT_INTERRUPT
	help
	  This option enables the UART driver for FOCALTECH family of processors.

if UART_FOCALTECH
config UART_INTERRUPT_DRIVEN
	bool "UART Interrupt support"
	depends on SERIAL_SUPPORT_INTERRUPT
	help
	  This option enables interrupt support for UART allowing console
	  input and other UART based drivers.
  
config UART_USE_RUNTIME_CONFIGURE
	bool "Runtime configuration for UART controllers"
	default y
	help
		Enable runtime configuration of UART controllers.
		This allows applications to call uart_configure() to
		configure the UART controllers at runtime, and calling
		uart_config_get() to retrieve configuration. If this is
		disabled, UART controllers rely on UART driver
		initialization function to properly configure
		the controller.
  
		Say y if unsure. Disable this to reduce footprint for
		applications that do not require runtime UART configuration.
  
  endif # UART_FOCALTECH
```

## modules/hal/focaltech_module/focaltech/drivers/spi/Kconfig.ft
```kconfig
# Copyright (c) 2023, Focaltech Systems CO.,Ltd
# SPDX-License-Identifier: Apache-2.0

config SPI_FOCALTECH
	bool "FT90 MCU serial driver"
	default y
	depends on SOC_FAMILY_FOCALTECH
	select USE_FOCALTECH_HAL_SPI
	select SPI_SLAVE
	help
	  This option enables the UART driver for FOCALTECH family of processors.

if SPI_FOCALTECH

config SPI_FOCALTECH_INTERRUPT
	bool "FOCALTECH MCU SPI Interrupt Support"
	default y if SPI_ASYNC
	help
	  Enable the interrupt driven mode for SPI instances

config SPI_FOCALTECH_DMA
	bool "FOCALTECH MCU SPI DMA Support"
	select DMA
	help
	  Use the DMA for SPI transfer
	  that enable dma channels in their device tree node.

config SPI_FOCALTECH_SLAVE
	bool "Slave support [EXPERIMENTAL]"
	select EXPERIMENTAL
	help
		Enables Driver SPI slave operations. Slave support depends
		on the driver and the hardware it runs on.


endif # SPI_FOCALTECH
```

## modules/hal/focaltech_module/focaltech/drivers/usb/Kconfig
```kconfig
# USB configuration options

# Copyright (c) 2016 Wind River Systems, Inc.
# SPDX-License-Identifier: Apache-2.0


if UDC_DRIVER

module = UDC_DRIVER
module-str = usb drv
source "subsys/logging/Kconfig.template.log_config"

#printk(INFO  "-------------------------------");

rsource "./udc/Kconfig"



endif # UDC_DRIVER
```

## modules/hal/focaltech_module/focaltech/drivers/usb/udc/Kconfig.ft
```kconfig
# Copyright (c) 2025 Neldtv
# SPDX-License-Identifier: Apache-2.0


config UDC_FOCALTECH
	bool "FOCALTECH for an USB device controller driver"
	default y
	depends on DT_HAS_ZEPHYR_UDC_FOCALTECH_ENABLED \
		|| DT_HAS_FT_FT90_USB_ENABLED 
	select USE_FOCALTECH_HAL_USB
	help
	  ccm for an USB device controller driver.

config UDC_FT_STACK_SIZE
	int "UDC controller driver internal thread stack size"
	depends on UDC_FOCALTECH
	default 4096
	help
	  ccm device controller driver internal thread stack size.

config UDC_FT_THREAD_PRIORITY
	int "FOCALTECH controller driver thread priority"
	depends on UDC_FOCALTECH
	default 8
	help
	  Skeleton device controller driver thread priority.

config UDC_FT_MAX_QMESSAGES
	int "UDC FOCALTECH message queue size"
	default 32
	help
	  Maximum number of messages the driver can queue for interrupt bottom half processing.

#config UDC_FT_DMA
#	bool "FT USB DMA support"
#	default y
#	help
#	  Enable Buffer DMA if DWC2 USB controller supports Internal DMA.
#	
```

## modules/hal/focaltech_module/focaltech/drivers/watchdog/Kconfig.ft
```kconfig
# Copyright (c) 2025 Focaltech Systems CO.,Ltd
# SPDX-License-Identifier: Apache-2.0

config WDT_FOCALTECH
	bool "FT90 MCU WDT driver"
	default y
	depends on WATCHDOG
	depends on SOC_FAMILY_FOCALTECH
	select USE_FOCALTECH_HAL_WDT 
	select HAS_WDT_DISABLE_AT_BOOT
	help
	  This option enables the WDT driver for FOCALTECH family of processors.
```

## modules/hal/focaltech_module/focaltech/dts/bindings/clock/ft,ft90-rcc.yaml
```yaml
# Copyright (c) 2022, Focaltech Systems CO.,Ltd
# SPDX-License-Identifier: Apache-2.0

description: |
  Predefined  clock cells are available in
  include/zephyr/dts-bindings/clock/ft90-clocks.h header files

compatible: "ft,ft90-rcc"

include: [clock-controller.yaml, base.yaml]

properties:
  "#clock-cells":
    const: 1

clock-cells:
  - id
```

## modules/hal/focaltech_module/focaltech/dts/bindings/counter/ft,ft90-timer.yaml
```yaml
# Copyright (c) 2025 Focaltech Systems CO.,Ltd
# SPDX-License-Identifier: Apache-2.0

description: Focaltech timer

compatible: "ft,ft90-timer"

include: [reset-device.yaml, base.yaml]

properties:
  clock-frequency:
    type: int
    default: 128000
    description: Clock frequency information for tc

  reg:
    required: true

  clocks:
    required: true

  resets:
    required: true

  channels:
    type: int
    default: 1
    description: Number of timer channels.

  prescaler:
    type: int
    enum:
    - 16
    - 32
    - 64
    - 128
    - 256
    - 512
    - 1024
    - 2048
    default: 16
    description: Timer prescaler. Defaults to 16 (SoC default).

  is-32bit:
    type: boolean
    description: Indicates if timer has a 32-bit counter.

  is-advanced:
    type: boolean
    description: |
      Indicates if timer has advanced features. Such features include break
      inputs, dead-time insertion, etc.
```

## modules/hal/focaltech_module/focaltech/dts/bindings/gpio/ft,ft90-gpio.yaml
```yaml
# Copyright 2017, 2024 Focaltech Systems CO.,Ltd
# SPDX-License-Identifier: Apache-2.0

description: FT90 GPIO node

compatible: "ft,ft90-gpio"

include: [gpio-controller.yaml, base.yaml, pinctrl-device.yaml, reset-device.yaml]

properties:
  reg:
    required: true
  interrupts:
    type: array
    required: true

  "#gpio-cells":
    const: 2
  mask:  
    description: "The GPIO mask for the device"
    type: int

gpio-cells:
  - pin
  - flags
```

## modules/hal/focaltech_module/focaltech/dts/bindings/pinctrl/ft,ft90-pinctrl.yaml
```yaml
# Copyright (c) 2021 Focaltech Systems CO.,Ltd
# SPDX-License-Identifier: Apache-2.0
description: |
    The ft90 pin controller.

compatible: "ft,ft90-pinctrl"
include: base.yaml

properties:
  reg:
    required: true

  clocks:
    required: true

child-binding:
  child-binding:
    include:
      - name: pincfg-node.yaml
        property-allowlist:
          - drive-push-pull
          - drive-open-drain
          - bias-disable
          - bias-pull-down
          - bias-pull-up

    properties:
      pinmux:
        required: true
        type: array
        description: |
          An array of pins sharing the same group properties. The pins should
          be defined using pre-defined macros or, alternatively.
      slew-rate:
        type: string
        default: "max-speed-2mhz"
        enum:
          - "max-speed-10mhz"
          - "max-speed-2mhz"
          - "max-speed-50mhz"
          - "max-speed-highest"
        description: |
          Set the maximum speed of a pin. This setting effectively limits the
          slew rate of the output signal. Defaults to "max-speed-2mhz", the SoC
          default. The max-speed-highest option may not be available on all SoC
          variants. If selected and not available the 50 MHz maximum speed will
          be used instead. Note that usage of max-speed-highest may require
          enabling the I/O compensation cell (refer to the gd,gd32-afio binding
          for more details).
```

## modules/hal/focaltech_module/focaltech/dts/bindings/reset/ft,ft90-rctl.yaml
```yaml
# Copyright (c) 2022, Focaltech Systems CO.,Ltd
# SPDX-License-Identifier: Apache-2.0

description: |
  Predefined RCU reset cells are available in
  include/zephyr/dts-bindings/reset/ft90{xxx}.h header files, where {xxx}
  corresponds to the SoC series, e.g. f4xx.

compatible: "ft,ft90-rctl"

include: [reset-controller.yaml, base.yaml]

properties:
  "#reset-cells":
    const: 1

reset-cells:
  - id
```

## modules/hal/focaltech_module/focaltech/dts/bindings/serial/ft,ft90-usart.yaml
```yaml
# Copyright (c) 2025 Focaltech Systems CO.,Ltd 
# SPDX-License-Identifier: Apache-2.0

description: ft usart

compatible: "ft,ft90-usart"

include: [uart-controller.yaml, reset-device.yaml, pinctrl-device.yaml]

properties:
  reg:
    required: true

  interrupts:
    required: true

  resets:
    required: false

  clocks:
    required: true
```

## modules/hal/focaltech_module/focaltech/dts/bindings/spi/ft,ft90-spi.yaml
```yaml
# Copyright (c) 2025 Focaltech Systems CO.,Ltd
# SPDX-License-Identifier: Apache-2.0
description: ft spi

compatible: "ft,ft90-spi"

include: [spi-controller.yaml, reset-device.yaml, pinctrl-device.yaml]

properties:
  reg:
    required: true

  interrupts:
    required: true

  resets:
    required: false

  clocks:
    required: true

  pinctrl-names:
    required: false

  guard_time:
    type: int
    default: 0
    description:
      SPI guard time during 2frames, (gdt[5:3]+1)*(2^gdt[2:0]+1)
```

## modules/hal/focaltech_module/focaltech/dts/bindings/usb/ft,ft90-usb.yaml
```yaml
# Copyright (c) 2017, I-SENSE group of ICCS
# SPDX-License-Identifier: Apache-2.0

description: CCM OTGFS controller

compatible: "ft,ft90-usb"

include: [usb-ep.yaml, reset-device.yaml, pinctrl-device.yaml]

properties:
  reg:
    required: true

  interrupts:
    required: true

  resets:
    required: false

  clocks:
    required: true

  pinctrl-names:
    required: false
```

## modules/hal/focaltech_module/focaltech/dts/bindings/watchdog/ft,ft90-wdt.yaml
```yaml
# Copyright (c) 2025 Focaltech Systems CO.,Ltd
# SPDX-License-Identifier: Apache-2.0

description: ft free watchdog timer

compatible: "ft,ft90-wdt"

include: [base.yaml, reset-device.yaml]

properties:
  reg:
    required: true

  initial-timeout-ms:
    type: int
    default: 250
    description: |
      Set timeout value in milliseconds.
      The following equation gives the maximum timeout value

        timeout = (reload + 1) / (peripheral_freqency / prescaler).

      where the prescaler = 4096 and the maximum reload = 65536.

      0.25 [timeout in sec] = (1999 [reload] + 1) / (32000 [freq] / 4 [prescaler])
      0.25 [timeout in sec] = (2499 [reload] + 1) / (40000 [freq] / 4 [prescaler])
```

## modules/hal/focaltech_module/focaltech/hal/Kconfig.ft
```kconfig
# Copyright (c) 2025 Focaltech Systems CO.,Ltd
# SPDX-License-Identifier: Apache-2.0

config ZEPHYR_HAL_FOCALTECH_MODULE
	bool
	
config HAS_FOCALTECH_HAL
	bool
	depends on SOC_FAMILY_FOCALTECH

config HAS_FOCALTECH_EXT_LIB
	bool
	depends on SOC_FAMILY_FOCALTECH

config HAS_FT9002LIB
	bool
	depends on SOC_FT9002S

config HAS_FT9001LIB
  bool
	depends on SOC_FT9001

if HAS_FT9002LIB || HAS_FT9001LIB

config USE_FOCALTECH_HAL_ADC
	bool
	help
	  Enable ft ADC module driver

config USE_FOCALTECH_HAL_ALG
	bool
	help
	  Enable ft alg module driver

config USE_FOCALTECH_HAL_C0
	bool
	help
	  Enable ft c0 module driver

config USE_FOCALTECH_HAL_CACHE
	bool
	help
	  Enable ft cache module driver

config USE_FOCALTECH_HAL_FOCALTECH
	bool
	help
	  Enable ft ft module driver

config USE_FOCALTECH_HAL_CPM
	bool
	help
	  Enable ft cpm module driver

config USE_FOCALTECH_HAL_CRC
	bool
	help
	  Enable ft crc module driver

config USE_FOCALTECH_HAL_DAC
	bool
	help
	  Enable ft dac module driver

config USE_FOCALTECH_HAL_DMAC
	bool
	help
	  Enable ft dmac module driver

config USE_FOCALTECH_HAL_EDMA
	bool
	help
	  Enable ft edma module driver

config USE_FOCALTECH_HAL_EFLASH
	bool
	help
	  Enable ft eflash module driver

config USE_FOCALTECH_HAL_EPORT
	bool
	help
	  Enable ft eport module driver

config USE_FOCALTECH_HAL_I2C
	bool
	help
	  Enable ft i2c module driver

config USE_FOCALTECH_HAL_IOCTRL
	bool
	help
	  Enable ft ioctrl module driver

config USE_FOCALTECH_HAL_PCI
	bool
	help
	  Enable ft pci module driver

config USE_FOCALTECH_HAL_PIT32
	bool
	help
	  Enable ft pit32 module driver

config USE_FOCALTECH_HAL_PWM
	bool
	help
	  Enable ft pwm module driver

config USE_FOCALTECH_HAL_RESET
	bool
	help
	  Enable ft reset module driver

config USE_FOCALTECH_HAL_RTC
	bool
	help
	  Enable ft rtc module driver

config USE_FOCALTECH_HAL_SPI
	bool
	help
	  Enable ft spi module driver

config USE_FOCALTECH_HAL_SSI
	bool
	help
	  Enable ft ssi module driver

config USE_FOCALTECH_HAL_TC
	bool
	help
	  Enable ft tc module driver

config USE_FOCALTECH_HAL_TRNG
	bool
	help
	  Enable ft trng module driver

config USE_FOCALTECH_HAL_TSI
	bool
	help
	  Enable ft tsi module driver

config USE_FOCALTECH_HAL_UART
	bool
	help
	  Enable ft uart module driver

config USE_FOCALTECH_HAL_USI
	bool
	help
	  Enable ft usi module driver

config USE_FOCALTECH_HAL_WDT
	bool
	help
	  Enable ft wdt module driver

config USE_FOCALTECH_HAL_XIP
	bool
	help
	  Enable ft xip module driver

config USE_FOCALTECH_HAL_USB
	bool
	help
	  Enable ft usb module driver

config UDC_DRIVER_HAS_HIGH_SPEED_SUPPORT
	bool
	help
	  Enable ft usb module driver


endif #HAS_FT9002LIB || HAS_FT9001LIB
```

## modules/hal/focaltech_module/focaltech/soc/ft/Kconfig.defconfig
```kconfig
# Copyright (c) 2025, Focaltech Systems CO.,Ltd
# SPDX-License-Identifier: Apache-2.0

if SOC_FAMILY_FOCALTECH

rsource "*/Kconfig.defconfig.series"

config RESET
	default y

config CLOCK_CONTROL
	default y

endif # SOC_FAMILY_FOCALTECH
```

## modules/hal/focaltech_module/focaltech/soc/ft/Kconfig.soc
```kconfig
# Copyright (c) 2025 Focaltech Systems CO.,Ltd
# SPDX-License-Identifier: Apache-2.0

config SOC_FAMILY_FOCALTECH
	bool

config SOC_FAMILY
	default "ft" if SOC_FAMILY_FOCALTECH

rsource "*/Kconfig.soc"
```

## modules/hal/focaltech_module/focaltech/soc/ft/ft90/Kconfig
```kconfig
# Copyright (c) 2021 Focaltech Systems CO.,Ltd
# SPDX-License-Identifier: Apache-2.0

config SOC_SERIES_FT90
	select ARM
	select CPU_CORTEX_M4
	select CPU_HAS_ARM_MPU
	select CPU_HAS_FPU
	select CPU_CORTEX_M_HAS_SYSTICK
	select CPU_CORTEX_M_HAS_VTOR
	select SOC_EARLY_INIT_HOOK
	#select HAS_FOCALTECH_EXT_LIB

config SOC_FT9002S
	select HAS_FOCALTECH_HAL
	select HAS_FT9002LIB
		
config SOC_FT9001
        select HAS_FOCALTECH_HAL
        select HAS_FT9001LIB
	#select HAS_PM
```

## modules/hal/focaltech_module/focaltech/soc/ft/ft90/Kconfig.defconfig.ft9001
```kconfig
# Copyright (c) 2025 Focaltech Systems CO.,Ltd
# SPDX-License-Identifier: Apache-2.0

if SOC_FT9001

config SYS_CLOCK_HW_CYCLES_PER_SEC
	default $(dt_node_int_prop_int,/cpus/cpu@0,clock-frequency)

config NUM_IRQS
	default 140

if PM

config COUNTER
	default y

config SYSTEM_CLOCK_SLOPPY_IDLE
	default y

endif # PM

endif # SOC_FT9001
```

## modules/hal/focaltech_module/focaltech/soc/ft/ft90/Kconfig.defconfig.series
```kconfig
# Copyright (c) 2025 Focaltech Systems CO.,Ltd
# SPDX-License-Identifier: Apache-2.0

if SOC_SERIES_FT90

rsource "Kconfig.defconfig.ft90*"

endif # SOC_SERIES_FT90
```

## modules/hal/focaltech_module/focaltech/soc/ft/ft90/Kconfig.soc
```kconfig
# Copyright (c) 2021 Focaltech Systems CO.,Ltd
# SPDX-License-Identifier: Apache-2.0

config SOC_SERIES_FT90
	bool
	select SOC_FAMILY_FOCALTECH
	help
	  Enable support for Focaltech FT90 MCU series

config SOC_SERIES
	default "ft90" if SOC_SERIES_FT90

config SOC_FT9002S
	bool
	select SOC_SERIES_FT90
	
config SOC_FT9001
	bool
	select SOC_SERIES_FT90

config SOC
	default "ft9002s" if SOC_FT9002S
	default "ft9001" if SOC_FT9001
```

## modules/hal/focaltech_module/mock/Kconfig.mock
```kconfig
# Copyright (c) 2025 Focaltech Systems CO.,Ltd
# SPDX-License-Identifier: Apache-2.0

config MOCK
	bool
	default y
```

## modules/hal/focaltech_module/mock/test/Kconfig
```kconfig
# SPDX-License-Identifier: Apache-2.0

if SPI

module = TEST
module-str = test
source "subsys/logging/Kconfig.template.log_config"

rsource "./Kconfig.*"

endif # SPI
```
