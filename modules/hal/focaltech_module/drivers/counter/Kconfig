## modules/hal/focaltech_module/drivers/counter/Kconfig
```kconfig
# SPDX-License-Identifier: Apache-2.0

menuconfig COUNTER
	bool "Counter drivers"
	help
	  Enable support for counter and timer.

if COUNTER

config COUNTER_INIT_PRIORITY
	int "Counter init priority"
	default 60
	help
	  Counter driver device initialization priority.

config COUNTER_SHELL
	bool "Counter shell"
	depends on SHELL
	help
	  Enable Shell Commands for Counter and Timer

module = COUNTER
module-str = counter
source "subsys/logging/Kconfig.template.log_config"

rsource "./Kconfig.*"

endif # COUNTER
```

## modules/hal/focaltech_module/drivers/flash/Kconfig
```kconfig
config FLASH_FT_FT90
	bool "FT FLASH driver"
	default y
#	depends on DT_HAS_FT_FT90_FLASH_CONTROLER_ENABLED
	select FLASH_HAS_DRIVER_ENABLED
	select FLASH_HAS_EXPLICIT_ERASE
#	select FLASH_EX_OP_ENABLED
	help
	  Enable driver for FT90

if FLASH_FT_FT90

config FLASH_EX_OP_ENABLED
	bool "FLASH EX OP"
	default y
	help
          Enable Flash ex op for FT90


config FLASH_FT_FT90_INIT_PRIORITY
	int
	default 80
	help
	  Device driver initialization priority.

endif
```

## modules/hal/focaltech_module/drivers/hwinfo/Kconfig
```kconfig
# SPDX-License-Identifier: Apache-2.0


if HWINFO

module = HWINFO
module-str = HWINFO
source "subsys/logging/Kconfig.template.log_config"

rsource "./Kconfig.*"

endif # HWINFO
```

## modules/hal/focaltech_module/drivers/hwinfo/Kconfig.ft
```kconfig
# Copyright (c) 2025 Focaltech Systems CO.,Ltd
# SPDX-License-Identifier: Apache-2.0

config HWINFO_FOCALTECH
	bool "FOCALTECH hwinfo"
	default y
	depends on SOC_FAMILY_FOCALTECH
	select HWINFO_HAS_DRIVER
	help
	  Enable FOCALTECH hwinfo driver.
```

## modules/hal/focaltech_module/drivers/otp/Kconfig.ft
```kconfig
# Copyright (c) 2021 Focaltech Systems CO.,Ltd
# SPDX-License-Identifier: Apache-2.0

config OTP_FT
	bool "Focaltech FT9001 OTP driver"
	default y
	depends on SOC_FAMILY_FOCALTECH
	select OTP_HAS_DRIVER
	help
	  This option enables the FT9001 OTP controller
	
```

## modules/hal/focaltech_module/drivers/pinctrl/Kconfig
```kconfig
# SPDX-License-Identifier: Apache-2.0

if PINCTRL

module = PINCTRL
module-str = PINCTRL
source "subsys/logging/Kconfig.template.log_config"

rsource "./Kconfig.*"

endif # PINCTRL
```

## modules/hal/focaltech_module/drivers/pinctrl/Kconfig.ft
```kconfig
# Copyright (c) 2025 Focaltech Systems CO.,Ltd
# SPDX-License-Identifier: Apache-2.0

config PINCTRL_FOCALTECH
	bool "PINCTRL Driver for FOCALTECH family of MCUs"
    default y
	depends on SOC_FAMILY_FOCALTECH
	help
	  This option enables the Pinctrl driver for FOCALTECH family of processors.
```

## modules/hal/focaltech_module/drivers/reset/Kconfig.ft
```kconfig
# Copyright (c) 2025 Focaltech Systems CO.,Ltd
# SPDX-License-Identifier: Apache-2.0

config RESET_FOCALTECH
	bool "FT90 reset control"
	default y
	depends on SOC_FAMILY_FOCALTECH
	help
	  Enable driver for FOCALTECH Reset Clock Unit (RCU).
```

## modules/hal/focaltech_module/drivers/serial/Kconfig
```kconfig
# SPDX-License-Identifier: Apache-2.0

if SERIAL

module = UART
module-str = uart
source "subsys/logging/Kconfig.template.log_config"

rsource "./Kconfig.*"

endif # SERIAL
```

## modules/hal/focaltech_module/drivers/spi/Kconfig
```kconfig
# SPDX-License-Identifier: Apache-2.0

if SPI

module = SPI
module-str = spi
source "subsys/logging/Kconfig.template.log_config"

rsource "./Kconfig.*"

endif # SPI
```

## modules/hal/focaltech_module/drivers/usb/Kconfig
```kconfig
# SPDX-License-Identifier: Apache-2.0


if UDC_DRIVER

module = UDC_DRIVER
module-str = usb drv
source "subsys/logging/Kconfig.template.log_config"

#printk(INFO  "-------------------------------");

rsource "./udc/Kconfig"



endif # UDC_DRIVER
```

## modules/hal/focaltech_module/dts/bindings/entropy/ft,ft90-entropy.yaml
```yaml
# Copyright (c) 2021 Focaltech Systems CO.,Ltd
# SPDX-License-Identifier: Apache-2.0
description: ft entropy

compatible: "ft,ft90-trng"

include: [base.yaml, reset-device.yaml]
```

## modules/hal/focaltech_module/dts/bindings/misc/ft,ft90-ftcfg.yaml
```yaml
# Copyright (c) 2025 Focaltech Systems CO.,Ltd
# SPDX-License-Identifier: Apache-2.0

description: ft ftcfg

compatible: "ft,ft90-ftcfg"

include: base.yaml

properties:
  reg:
    required: true

  clocks:
    required: true
```

## modules/hal/focaltech_module/dts/bindings/usb/ft,ft90-usb.yaml
```yaml
# Copyright (c) 2025 Focaltech Systems CO.,Ltd
# SPDX-License-Identifier: Apache-2.0

description: OTGFS controller

compatible: "ft,ft90-usb"

include: [usb-ep.yaml, reset-device.yaml, pinctrl-device.yaml]

properties:
  reg:
    required: true

  interrupts:
    required: true

  resets:
    required: false

  clocks:
    required: true

  pinctrl-names:
    required: false
```

## modules/hal/focaltech_module/focaltech/boards/ft/ft9001_eval/Kconfig.ft9001_eval
```kconfig
# Copyright (c) 2025 Focaltech Systems CO.,Ltd
# SPDX-License-Identifier: Apache-2.0

config BOARD_FT9001_EVAL
	bool "FT9001_EVAL"
	select SOC_FT9001

config FLASH_LOAD_OFFSET
	default 0x1000
```

## modules/hal/focaltech_module/focaltech/boards/ft/ft9001_eval/board.yml
```yaml
# Copyright (c) 2025 Focaltech Systems CO.,Ltd
# SPDX-License-Identifier: Apache-2.0

board:
  name: ft9001_eval
  full_name: FT9001-EVAL
  vendor: ft
  socs:
    - name: ft9001
```

## modules/hal/focaltech_module/focaltech/boards/ft/ft9001_eval/ft9001_eval_defconfig
```kconfig
# Copyright (c) 2025 Focaltech Systems CO.,Ltd
# SPDX-License-Identifier: Apache-2.0

CONFIG_ARM_MPU=y
CONFIG_HW_STACK_PROTECTION=y

#CONFIG_FPU=y

#CONFIG_FP_HARDABI=y

CONFIG_CONSOLE=y
CONFIG_UART_CONSOLE=y
CONFIG_SERIAL=y

CONFIG_GPIO=y
CONFIG_SPI_ASYNC=y
CONFIG_PINCTRL=y

CONFIG_UART_INTERRUPT_DRIVEN=y

#CONFIG_FLASH_LOAD_OFFSET=0x1000


CONFIG_HWINFO=y
CONFIG_HWINFO_FOCALTECH=y
CONFIG_LOG=y
```

## modules/hal/focaltech_module/focaltech/drivers/counter/Kconfig.ft
```kconfig
# Copyright (c) 2023, Focaltech Systems CO.,Ltd
# SPDX-License-Identifier: Apache-2.0

config COUNTER_TIMER_FOCALTECH
	bool "FOCALTECH timer counter driver"
	default y
	depends on DT_HAS_FT_FT90_TIMER_ENABLED
	select USE_FOCALTECH_HAL_TC
	help
	  Enable counter timer driver for FOCALTECH series devices.
```

## modules/hal/focaltech_module/focaltech/drivers/entropy/Kconfig.ft
```kconfig
# Copyright (c) 2021 Focaltech Systems CO.,Ltd
# SPDX-License-Identifier: Apache-2.0

config ENTROPY_FT
	bool "Focaltech FT9001 TRNG driver"
	default y
	depends on ENTROPY_GENERATOR
	depends on SOC_FAMILY_FOCALTECH
	select ENTROPY_HAS_DRIVER
	help
	  This option enables the FT9001 true random number generator (TRNG)
	
```

## modules/hal/focaltech_module/focaltech/drivers/flash/Kconfig
```kconfig
config FLASH_FT_FT90
	bool "FT FLASH driver"
	default y
#	depends on DT_HAS_FT_FT90_FLASH_CONTROLER_ENABLED
	select FLASH_HAS_DRIVER_ENABLED
	select FLASH_HAS_EXPLICIT_ERASE
	help
	  Enable driver for FT90

if FLASH_FT_FT90

config FLASH_FT_FT90_INIT_PRIORITY
	int
	default 80
	help
	  Device driver initialization priority.

endif
```

## modules/hal/focaltech_module/focaltech/drivers/flash/Kconfig.ft
```kconfig
# Copyright (c) 2021 Focaltech Systems CO.,Ltd
# SPDX-License-Identifier: Apache-2.0

config FLASH_FT_FT90
	bool "FLASH FT FT90"
	default y
	
```

## modules/hal/focaltech_module/focaltech/drivers/gpio/Kconfig.ft
```kconfig
# Copyright (c) 2025 Focaltech Systems CO.,Ltd
# SPDX-License-Identifier: Apache-2.0

config GPIO_FOCALTECH
	bool "FT90 GPIO driver"
	default y
	depends on GPIO
	depends on SOC_FAMILY_FOCALTECH
	select USE_FOCALTECH_HAL_EPORT 
	help
	  Enable the FOCALTECH GPIO driver.
```

## modules/hal/focaltech_module/focaltech/drivers/hwinfo/Kconfig.ft
```kconfig
config HWINFO_FOCALTECH
	bool "FOCALTECH hwinfo"
	default y
	depends on SOC_FAMILY_FOCALTECH
	select HWINFO_HAS_DRIVER
	help
	  Enable FOCALTECH hwinfo driver.
```

## modules/hal/focaltech_module/focaltech/drivers/otp/Kconfig
```kconfig
# SPDX-License-Identifier: Apache-2.0

if ENTROPY_GENERATOR

module = OTP
module-str = otp
source "subsys/logging/Kconfig.template.log_config"

rsource "./Kconfig.*"

endif
```

## modules/hal/focaltech_module/focaltech/drivers/reset/Kconfig
```kconfig
# SPDX-License-Identifier: Apache-2.0

if RESET

module = RESET
module-str = reset
source "subsys/logging/Kconfig.template.log_config"

rsource "./Kconfig.*"

endif # RESET
```
