## modules/hal/focaltech_module/dts/bindings/gpio/focaltech,ft9001-gpio.yaml
```yaml
# Copyright 2025 Focaltech Systems CO.,Ltd
# SPDX-License-Identifier: Apache-2.0

description: FT90 GPIO node

compatible: "focaltech,ft9001-gpio"

include: [gpio-controller.yaml, base.yaml, pinctrl-device.yaml, reset-device.yaml]

properties:
  reg:
    required: true
  interrupts:
    type: array
    required: true

  "#gpio-cells":
    const: 2
  mask:  
    description: "The GPIO mask for the device"
    type: int

gpio-cells:
  - pin
  - flags
```

## modules/hal/focaltech_module/dts/bindings/misc/focaltech,ft9001-ccm.yaml
```yaml
# Copyright (c) 2025 Focaltech Systems CO.,Ltd
# SPDX-License-Identifier: Apache-2.0

description: ft ccm

compatible: "focaltech,ft9001-ccm"

include: base.yaml

properties:
  reg:
    required: true

  clocks:
    required: true
```
