## modules/hal/egis_module/Kconfig
```kconfig
rsource "boards/egis/egis_et171/Kconfig.egis_et171"
rsource "boards/egis/egis_et171/Kconfig.defconfig"
rsource "soc/egis/et171/Kconfig.defconfig"
rsource "drivers/Kconfig"
```

## modules/hal/egis_module/boards/egis/egis_et171/Kconfig.defconfig
```kconfig
config TIMER_READS_ITS_FREQUENCY_AT_RUNTIME
	default y
	depends on DT_HAS_EGIS_ET171_CLOCK_ENABLED

config HWINFO
	default y
```

## modules/hal/egis_module/boards/egis/egis_et171/Kconfig.egis_et171
```kconfig
# Copyright (c) 2025 Egis Technology Inc.
# SPDX-License-Identifier: Apache-2.0

config EGIS_JTAG
	bool "Enable debug with JTAG"
	depends on SOC_EGIS_ET171
	default y

config EGIS_PAD_PULLDOWN
	hex
	depends on SOC_EGIS_ET171
	default 0x0000001F
	help
	  Used to fine-tune the I/O level of each pad, even if it is not
	  bonded out. This can be used for more detailed tuning of power
	  consumption.
```

## modules/hal/egis_module/drivers/clock_control/Kconfig
```kconfig
if CLOCK_CONTROL

module = CLOCK_CONTROL
module-str = clock control
source "subsys/logging/Kconfig.template.log_config"

rsource "./Kconfig.*"

endif # CLOCK_CONTROL
```

## modules/hal/egis_module/drivers/clock_control/Kconfig.et171
```kconfig
#
# Copyright (c) 2025 Egis Technology Inc.
# SPDX-License-Identifier: Apache-2.0
#

config CLOCK_CONTROL_ET171
	bool "ET171 clock control driver"
	default y
	depends on DT_HAS_EGIS_ET171_CLOCK_ENABLED
	select HAS_EGIS_ET171_HAL
	help
	  This option enables the clock driver for Egis ET171 SOC.
```

## modules/hal/egis_module/drivers/crypto/Kconfig
```kconfig
# Crypto configuration options

# SPDX-License-Identifier: Apache-2.0

if CRYPTO

config CRYPTO_INIT_PRIORITY
	int "Crypto devices init priority"
	default 90
	help
	  Crypto devices initialization priority.

module = CRYPTO
module-str = CRYPTO
source "subsys/logging/Kconfig.template.log_config"

rsource "Kconfig.et171"

endif # CRYPTO
```

## modules/hal/egis_module/drivers/crypto/Kconfig.et171
```kconfig
# Copyright (c) 2025 Egis Technology Inc.
# SPDX-License-Identifier: Apache-2.0

config CRYPTO_EGIS_ET171
	bool "Egis ET171 SHA driver"
	default y
	depends on DT_HAS_EGIS_ET171_SHA_ENABLED
	select HAS_EGIS_ET171_HAL
	select HAS_EGIS_ET171_SXSMCRYPT
	help
	  Enable Egis ET171 SHA driver.
	  This driver supports hardware accelerator to calculate
	  SHA-2 hash.
```

## modules/hal/egis_module/drivers/entropy/Kconfig
```kconfig
# Entropy generator driver configuration options

# Copyright (c) 2025 Egis Technology Inc.
# SPDX-License-Identifier: Apache-2.0

if ENTROPY_GENERATOR

module = ENTROPY
module-str = entropy
source "subsys/logging/Kconfig.template.log_config"

rsource "Kconfig.egis"

endif # ENTROPY_GENERATOR
```

## modules/hal/egis_module/drivers/entropy/Kconfig.egis
```kconfig
# Egis entropy configuration options

# Copyright 2025 Egis Technology Inc.
# SPDX-License-Identifier: Apache-2.0

config ENTROPY_EGIS_ET171_TRNG
	bool "Egis TRNG driver"
	default y
	depends on DT_HAS_EGIS_ET171_TRNG_ENABLED
	select ENTROPY_HAS_DRIVER
	select HAS_EGIS_ET171_HAL
	select HAS_EGIS_ET171_SXSMCRYPT
	help
	  This option enables the true random number generator (TRNG)
```

## modules/hal/egis_module/drivers/hwinfo/Kconfig
```kconfig
# HW Info driver configuration options

# Copyright (c) 2025 Egis Technology Inc.
# SPDX-License-Identifier: Apache-2.0

if HWINFO

module = HWINFO
module-str = HWINFO control
source "subsys/logging/Kconfig.template.log_config"

rsource "Kconfig.et171"

endif # HWINFO
```

## modules/hal/egis_module/drivers/hwinfo/Kconfig.et171
```kconfig
# Copyright The Zephyr Project Contributors
# SPDX-License-Identifier: Apache-2.0

config HWINFO_ET171
	bool "Egis et171 hwinfo"
	default y
	depends on SOC_EGIS_ET171
	select HWINFO_HAS_DRIVER
	select HAS_EGIS_ET171_HAL
	help
	  Enable Egis et171 hwinfo driver
```

## modules/hal/egis_module/drivers/pinctrl/Kconfig
```kconfig
# Copyright (c) 2025 Egis Technology Inc.
# SPDX-License-Identifier: Apache-2.0

if PINCTRL

module = PINCTRL
module-str = PINCTRL
source "subsys/logging/Kconfig.template.log_config"

rsource "Kconfig.egis_et171"

endif # PINCTRL
```

## modules/hal/egis_module/drivers/pinctrl/Kconfig.egis_et171
```kconfig
# Copyright (c) 2025 Egis Technology Inc.
# SPDX-License-Identifier: Apache-2.0

config PINCTRL_EGIS_ET171
	bool "Egis et171 pin controller"
	default y
	depends on DT_HAS_EGIS_ET171_PINCTRL_ENABLED
    select HAS_EGIS_ET171_HAL
	help
	  Enables Egis et171 pin controller
```

## modules/hal/egis_module/drivers/usb/udc/Kconfig
```kconfig
if UDC_DRIVER

module = UDC_DRIVER
module-str = usb drv
source "subsys/logging/Kconfig.template.log_config"

rsource "./Kconfig.*"

endif # UDC_DRIVER
```

## modules/hal/egis_module/drivers/usb/udc/Kconfig.et171
```kconfig
# Copyright (c) 2022 Nordic Semiconductor ASA
# SPDX-License-Identifier: Apache-2.0

config UDC_ET171
	bool "ET171 USB device controller driver"
	depends on DT_HAS_EGIS_ET171_USBD_ENABLED
	select HAS_EGIS_ET171_HAL
	select HAS_EGIS_ET171_USBCORE
	default y
	help
	  et171 USB Device Controller Driver.

if UDC_ET171

config UDC_ET171_WORKQUEUE
	bool "Use an internal work queue for UDC drivers"
	default y if !UDC_WORKQUEUE
	help
	  This option provides a dedicated work queue for UDC drivers.

config UDC_ET171_WORKQUEUE_STACK_SIZE
	int "UDC controller driver internal workqueue stack size"
	depends on UDC_ET171_WORKQUEUE
	default 1024

config UDC_ET171_WORKQUEUE_PRIORITY
	int "UDC controller driver internal workqueue priority"
	depends on UDC_ET171_WORKQUEUE
	default 2
	help
	  Device controller driver thread priority.

endif # UDC_ET171
```

## modules/hal/egis_module/dts/bindings/clock/egis,et171-clock.yaml
```yaml
# Copyright (c) 2025, Egis Technology Inc.
# SPDX-License-Identifier: Apache-2.0

description: ET171 clock controller node

compatible: "egis,et171-clock"

include:
  - base.yaml
  - clock-controller.yaml

properties:
  "#clock-cells":
    const: 1

  ahb-divide:
    type: int
    enum: [1, 2, 3, 4, 6, 8, 16]
    description: |
      The divide number of AHB base clock for bus.
      That cannot be used simultaneously with ahb-clock.

  ahb-clock:
    type: int
    description: |
      Advanced High-performance Bus clock frequence.
      This is not a precise clock setting, but rather uses the root clock
      to automatically select the most suitable ahb-divide.
      That cannot be used simultaneously with ahb-divide.

  apb-divide:
    type: int
    enum: [1, 2, 3, 4, 6, 8, 16]
    description: |
      The divide number of APB base clock for bus.
      That cannot be used simultaneously with apb-clock.

  apb-clock:
    type: int
    description: |
      Advanced Peripheral Bus clock frequence.
      This is not a precise clock setting, but rather uses the AHB clock
      to automatically select the most suitable apb-divide.
      That cannot be used simultaneously with apb-divide.

clock-cells:
  - clkid
```

## modules/hal/egis_module/dts/bindings/crypto/egis,et171-crypto.yaml
```yaml
# Copyright (c) 2025, Egis Technology Inc.
# SPDX-License-Identifier: Apache-2.0

description: Egis ET171 Crypto SHA accelerator.

compatible: "egis,et171-sha"

include: base.yaml
```

## modules/hal/egis_module/dts/bindings/gpio/egis_et171-ext-wdt.yaml
```yaml
# egis,et171-ext-wdt.yaml

description: Extern watch dog reset control signals

compatible: "egis,et171-ext-wdt"

include: [base.yaml, pinctrl-device.yaml]

properties:
  pwm-channel:
    type: int
    required: true
    description: pwm channel number used for wdt reset
    enum: [0, 1, 2, 3]
```

## modules/hal/egis_module/dts/bindings/pinctrl/egis,et171-pinctrl.yaml
```yaml
# Copyright (c) 2025, Egis Technology Inc.
# SPDX-License-Identifier: Apache-2.0

compatible: "egis,et171-pinctrl"

include: base.yaml

description: |
    et171 pin controller

child-binding:
  description: |
    This binding gives a base representation of the et171 pins
    configuration

  properties:
    pinmux:
      type: int
      required: true
      description: Pinmux selection
```

## modules/hal/egis_module/dts/bindings/rng/egis,et171-trng.yaml
```yaml
# Copyright (c) 2025, Egis Technology Inc.
# SPDX-License-Identifier: Apache-2.0

description: Egis ET171 true random number generator.

compatible: "egis,et171-trng"

include: base.yaml
```

## modules/hal/egis_module/dts/bindings/usb/egis,et171-usbd.yaml
```yaml
# Copyright (c) 2025 Egis Technology Inc
# SPDX-License-Identifier: Apache-2.0

description: Egis USB device controller

compatible: "egis,et171-usbd"

include: usb-ep.yaml

properties:
  reg:
    required: true

  interrupts:
    required: true
```

## modules/hal/egis_module/soc/egis/et171/Kconfig.defconfig
```kconfig
# Copyright (c) 2025 Egis Technology Inc.
# SPDX-License-Identifier: Apache-2.0

config SOC_EGIS_ET171
	select HAS_PM

if SOC_EGIS_ET171

config HAS_EGIS_ET171_HAL
	default y

if PM

config PM_SOC_ET171_PREVENT_UART_RX_INCORRECT
	bool "Prevent SOC from entering low-power mode when RX UART RX is ready"
	default n
	depends on DT_HAS_NS16550_ENABLED && UART_INTERRUPT_DRIVEN
	help
	  When the SoC enters a low-power state, the UART clock frequency also changes.
	  This means it cannot correctly analyze the RX signal.
	  Therefore, to prevent this error from occurring when the RX is ready to receive
	  data, the SoC is prevented from entering low-power mode.

endif # PM

config CLOCK_CONTROL
	# Auto select 'CLOCK_CONTROL' when ns16550 doesn't have porperty 'clock-frequency'
	default y
	depends on DT_HAS_NS16550_ENABLED
	depends on !$(dt_compat_any_has_prop,$(DT_COMPAT_NS16550),clock-frequency)

endif # SOC_EGIS_ET171
```

## modules/hal/focaltech_module/Kconfig
```kconfig
# SPDX-License-Identifier: Apache-2.0

rsource "drivers/Kconfig"
rsource "hal/Kconfig.ft"
#rsource "mock/Kconfig.mock"
```

## modules/hal/focaltech_module/drivers/clock_control/Kconfig.ft
```kconfig
# Copyright (c) 2025 Focaltech Systems CO.,Ltd
# SPDX-License-Identifier: Apache-2.0

config CLOCK_CONTROL_FT90
	bool "FT90 clock control"
	default y
	depends on SOC_FAMILY_FOCALTECH
	help
	  Enable driver for Gigadevice Reset Clock Unit (RCU).
```
